## Kconfig
```kconfig
menu "Dalybms"

    config UART_TIMEOUT_MS
        int "UART timeout"
        default 1000

    config MAX_HEADER_SEARCH
        int "Number of times to ping for header"
        default 4

endmenu
```

## example/main/Kconfig.projbuild
```kconfig
menu "Example"

    config UART_TX
        int "TX pin"
        default 17

    config UART_RX
        int "RX pin"
        default 5

    config UART1_RX_BUFSIZE
        int "RX buffer size"
        default 1024

    config UART1_TX_BUFSIZE
        int "TX buffer size"
        default 1024

endmenu
```
